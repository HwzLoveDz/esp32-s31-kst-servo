## examples/headless_poll/sdkconfig.defaults
```kconfig
CONFIG_IDF_TARGET="esp32s31"
CONFIG_ESPTOOLPY_FLASHSIZE_16MB=y
CONFIG_ESP_MAIN_TASK_STACK_SIZE=6144
# CONFIG_TWAI_ISR_CACHE_SAFE is not set
# CONFIG_PM_ENABLE is not set
```

## main/Kconfig.projbuild
```kconfig
menu "KST CAN servo / Korvo FUI"
choice KST_TRANSPORT
    prompt "CAN transport"
    default KST_TRANSPORT_USB_GS
config KST_TRANSPORT_USB_GS
    bool "candleLight / gs_usb on Korvo USB-A"
config KST_TRANSPORT_TWAI
    bool "Native TWAI with external CAN transceiver"
endchoice
config KST_TX_GPIO
    int "TWAI TX GPIO (camera connector J4 pin 19)"
    range 0 60
    default 46
    depends on KST_TRANSPORT_TWAI
config KST_RX_GPIO
    int "TWAI RX GPIO (camera connector J4 pin 21)"
    range 0 60
    default 47
    depends on KST_TRANSPORT_TWAI
config KST_NODE_ID
    int "Initial servo node (decimal; 37 = 0x25)"
    range 1 127
    default 37
config KST_BITRATE
    int "Initial CAN bitrate"
    default 500000
config KST_TIMEOUT_MS
    int "Request / transport timeout (ms)"
    range 50 1000
    default 200
config KST_STALE_MS
    int "Disarm motion when position or status is stale (ms)"
    range 500 5000
    default 800
config KST_DIAGNOSTIC_LOG
    bool "Print readback and transport diagnostics every 2 seconds"
    default y
    help
        Print actual readback validity, raw units and transport counters to
        the serial console from the CAN worker. Does not issue extra CAN
        requests or change the FUI operation log. Disable for quieter output.
config KST_DISCOVER_ON_START
    bool "Probe extended-CAN nodes 1..127 once after USB startup"
    depends on KST_TRANSPORT_USB_GS
    default n
    help
        If initial readbacks receive no valid reply, send one broadcast READ
        NODE and log raw replies for 500 ms, then read the version from each
        unicast node with a 200 ms timeout. Report matches on the serial console
        without changing the selected node or servo settings.
        Motion is disarmed and queued UI commands are invalidated. PAUSE or a
        USB connection change aborts the scan. Only extended read requests.
config KST_PROBE_360_ON_START
    bool "TEMPORARY: probe node 5 firmware 3.66 limit acceptance once"
    depends on KST_TRANSPORT_USB_GS
    default n
    help
        Diagnostic only. After the first USB-ready startup readback, require
        node 5, firmware 3.66, complete fresh telemetry and an in-range position.
        Try +180 degrees once, restore and verify the original positive limit,
        then try -180 degrees only if the positive probe and restore succeeded.
        No position, center, feature or SAVE commands. Missing prerequisites
        skip the probe permanently for this boot. PAUSE cancels further trials;
        necessary restoration continues only on the same USB connection.
        Unverified restoration latches a ban on motion and parameter writes.
        Disable after diagnosis. Acceptance does not prove mechanical travel.
endmenu
```

## sdkconfig.defaults
```kconfig
CONFIG_IDF_TARGET="esp32s31"
CONFIG_KST_TRANSPORT_USB_GS=y
# This bench servo replied as node 5 at 1 Mbit/s (firmware 3.66).
# The vendor protocol's generic factory defaults are 37 / 500 kbit/s.
CONFIG_KST_NODE_ID=5
CONFIG_KST_BITRATE=1000000
CONFIG_KST_DISCOVER_ON_START=y
CONFIG_ESPTOOLPY_FLASHSIZE_16MB=y
CONFIG_ESPTOOLPY_FLASHSIZE="16MB"
CONFIG_SPIRAM=y
CONFIG_SPIRAM_XIP_FROM_PSRAM=y
CONFIG_SPIRAM_MALLOC_ALWAYSINTERNAL=0
CONFIG_PARTITION_TABLE_CUSTOM=y
CONFIG_PARTITION_TABLE_CUSTOM_FILENAME="partitions.csv"
CONFIG_PARTITION_TABLE_OFFSET=0x8000
CONFIG_ESP_MAIN_TASK_STACK_SIZE=8192
CONFIG_LV_CONF_SKIP=y
CONFIG_LV_COLOR_DEPTH_16=y
CONFIG_LV_COLOR_DEPTH=16
CONFIG_LV_USE_CLIB_MALLOC=y
# CONFIG_LV_USE_BUILTIN_MALLOC is not set
# CONFIG_LV_BUILD_EXAMPLES is not set
# CONFIG_LV_BUILD_DEMOS is not set
CONFIG_LV_FONT_MONTSERRAT_12=y
CONFIG_LV_FONT_MONTSERRAT_14=y
CONFIG_LV_FONT_MONTSERRAT_16=y
CONFIG_LV_FONT_MONTSERRAT_20=y
CONFIG_LV_FONT_MONTSERRAT_24=y
CONFIG_LV_FONT_MONTSERRAT_36=y
CONFIG_LV_FONT_MONTSERRAT_48=y
CONFIG_LV_USE_LINE=y
CONFIG_LV_USE_BAR=y
CONFIG_LV_USE_LABEL=y
CONFIG_LV_USE_SLIDER=y
CONFIG_LV_USE_DROPDOWN=y
CONFIG_LV_USE_SPINBOX=y
CONFIG_LV_USE_CHART=y
CONFIG_LV_USE_ARC=y
CONFIG_LV_USE_BUTTON=y
CONFIG_LV_USE_SWITCH=y
# CONFIG_TWAI_ISR_CACHE_SAFE is not set
# CONFIG_PM_ENABLE is not set
```
